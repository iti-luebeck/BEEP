#include "ir_driver.h"

const uint8_t scaleIRTable[2048] PROGMEM = {
	0, 0, 23, 37, 46, 54, 60, 65, 70, 73, 77, 80,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 255
};

volatile bool ir_raw_stored = false; //indicates whether daylight measurement is stored
volatile uint8_t conv_left = 0; // nuber of conversions the adc will do until adc_task is set to ADC_TASK_IDLE

const uint8_t ir_led_lut[8] PROGMEM = {0,1,2,3,5,6,7,4};
	
volatile uint8_t adc_task; // task the adc is currently working with
volatile uint8_t cur_ir_led; // index of the led. Used to measure multiple channels
volatile uint16_t last_adc; // used to store measured daylight for daylight-filter

typedef struct Buffer{
	/* \brief Array of stored data*/
	uint8_t data[BUFFER_SIZE];
	/* \brief index of the next position to store data in*/
	uint8_t head;
}Buffer_t;

Buffer_t ir_data_buffer; // Stores daylight filtered ir values for average filter

// lut for pin allocation of ir and rgb leds
extern const uint8_t ir_led_lut[8] PROGMEM;
	

/*! \brief ADC enabled, signed mode, 12 bit resolution, 512 clock divider, interupts enabled*/
void init_adc(void){
	ADCA.CTRLA = ADC_ENABLE_bm; //enable adc
	ADCA.CTRLB = ADC_CONMODE_bm | ADC_RESOLUTION_12BIT_gc; //signed mode, no current limit, no freerun, 12 bit resolution (max value: 2047)
	ADCA.PRESCALER = ADC_PRESCALER_DIV512_gc; //Set 512 clock divider
	ADCA.REFCTRL = ADC_REFSEL_INT1V_gc; // use internal 1V ref
	
	ADCA.CH0.INTCTRL = ADC_CH_INTMODE_COMPLETE_gc|ADC_CH_INTLVL_LO_gc; //low priority interrupt on conv complete
}

/*! \brief init ir leds (set multiplex chanels as outputs)*/
void init_ir_led(void){
	PORTF.DIRSET = PIN0_bm | PIN1_bm | PIN2_bm;
}

void init_ir_driver(void){
	init_adc();
	init_ir_led();
}
	




/*! \brief starts adc-conversion on the inputpin input.
*	\param input pin to measure voltage. (values: 0 to 15)
*/
void start_adc(uint8_t input){
	//input between 0 and 15
	ADCA.CH0.MUXCTRL = (input<<3) | ADC_CH_MUXNEG_PIN1_gc; //setup mux: input channel | refference voltage
	ADCA.CH0.CTRL = ADC_CH_START_bm | ADC_CH_GAIN_1X_gc | ADC_CH_INPUTMODE_DIFF_gc; //start conv with 1x gain, diff mode
}





/*! \brief enable led of ir distance sensor
*	\param led index of led
*/
void ir_led_enable(uint8_t led){
	PORTF.OUTCLR = 0b111;
	PORTF.OUTSET = pgm_read_word(&ir_led_lut[led]);
}

/*! \brief Measures distance
*	Starts measurement of ir distance.
*	led can be turned on or off (off: different led is turned on. WORKAROUND)
*/
void measure_ir_distance(uint8_t ir_led, bool led_enabled){
	if (led_enabled){
		ir_led_enable(ir_led);
		}else{
		ir_led_enable((ir_led + 1) % 8);
	}
	start_adc(ir_led + 8);
}


void measure_ir_distances(uint8_t start_led, uint8_t count, bool filtered){
	if (count == 1 && filtered){
		adc_task = ADC_TASK_IR_FILTERED_ONCE;
		ir_raw_stored = false;
		ir_led_enable((start_led + 1) % 8); //Enable different LED (Workaround)
		conv_left = count * 2 * BUFFER_SIZE;
		
		}else if(count == 1 && ~filtered){
		adc_task = ADC_TASK_IR_ONCE;
		conv_left = count;
		ir_led_enable(start_led);
		
		}else if(count > 1 && filtered){
		adc_task = ADC_TASK_IR_FILTERED_CONTINUES;
		ir_raw_stored = false;
		ir_led_enable((start_led + 1) % 8); //Enable different LED (Workaround)
		conv_left = count * 2 * BUFFER_SIZE; //  for each ir sensor measure once with enabled and once with disabled led
		
		}else if(count > 1 && ~filtered){
		adc_task = ADC_TASK_IR_CONTINUES;
		ir_led_enable(start_led);
		conv_left = count; //  for each ir sensor measure once with enabled led
	}
	ir_data_buffer.head = 0;
	cur_ir_led = start_led;
	start_adc(start_led + 8);
}

bool ir_driver_is_measuring(void){
	return conv_left > 0;
}


void ISR_adc_ir_driver()
{
	conv_left -= 1;
	
	if (adc_task == ADC_TASK_IR_CONTINUES || adc_task == ADC_TASK_IR_ONCE){
		// no filter, transmit result without any manipulation (except scaling to uint8)
		USART_TXBuffer_PutByte(&USART_data, ADCA.CH0.RES / (2047 / 255));
		cur_ir_led += 1;
		if (conv_left>0){
			measure_ir_distance(cur_ir_led, true);
		}
		
		}else if(adc_task == ADC_TASK_IR_FILTERED_CONTINUES || adc_task == ADC_TASK_IR_FILTERED_ONCE){
		// filter activated
		if (ir_raw_stored){
			if (ADCA.CH0.RES < last_adc){
				ir_data_buffer.data[ir_data_buffer.head] = 0;
				}else{
				ir_data_buffer.data[ir_data_buffer.head] = pgm_read_word (&scaleIRTable[ADCA.CH0.RES - last_adc]);
			}
			ir_data_buffer.head += 1;
			
			if (ir_data_buffer.head == BUFFER_SIZE){
				// enough measurements stored, calculate average
				ir_data_buffer.head = 0;
				uint16_t avr_ir = 0;
				for (uint8_t i = 0;  i < BUFFER_SIZE; i++){
					avr_ir += ir_data_buffer.data[i];
				}
				avr_ir /= BUFFER_SIZE;
				USART_TXBuffer_PutByte(&USART_data, avr_ir);
				cur_ir_led += 1;
			}
			ir_raw_stored = false;
			if (conv_left>0){
				measure_ir_distance(cur_ir_led, false);
			}
			}else{
			//store daylight value and measure value with turned on led again
			ir_raw_stored = true;
			last_adc = ADCA.CH0.RES;
			measure_ir_distance(cur_ir_led, true);
		}
	}
}